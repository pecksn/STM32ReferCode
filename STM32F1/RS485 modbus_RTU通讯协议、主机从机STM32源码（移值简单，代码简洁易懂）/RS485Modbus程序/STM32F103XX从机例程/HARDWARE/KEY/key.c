/****************************************************************************************************************
@文件名称:KEY.C
@功能说明:初始化硬件按键对应的GPIO模式
@版    本:V1.0.0
@版权所有:
@日    期:2017-9-26
@编    写:xie
@接口说明:  
@修改日志:
****************************************************************************************************************/
#include "key.h"
#include "delay.h"


/***************************************************************************************************************
@函数名称:按键端口初始化函数
@入口参数:无
@出口参数:无
@功能说明:初始化硬件连接的GPIO模式 
***************************************************************************************************************/
void KeyInit(void)
{
	GPIO_InitTypeDef GPIO_InitStructure;
	RCC_APB2PeriphClockCmd(KEY_RCC ,ENABLE);								//使能端口时钟
	
	GPIO_InitStructure.GPIO_Pin = 	KEY_READ_Pin  | KEY_WRITE_Pin;			//端口配置
	GPIO_InitStructure.GPIO_Mode = GPIO_Mode_IPU;							//上拉输入
	GPIO_Init(KEY_PORT,&GPIO_InitStructure);								//初始化GPIO为上拉输入功能
}
/***************************************************************************************************************
@函数名称:按键扫描函数
@入口参数:mode    1可重复进入即连按模式  0不可连按
@出口参数:u8型 按键值   
@功能说明:按键扫描，返回一个值 用来识别是那一个按键按下
***************************************************************************************************************/
u8 KeyScan(unsigned char ucMode)
{
	static unsigned char ucKeyFlag = 0;				//松开或按下标志 0按下 1松开
	if(ucMode)
		ucKeyFlag = 1;
	if((ucKeyFlag) && (!KEY_READ || !KEY_WRITE))	//扫描 任意一个按键是否按下 同时松开标志为1 即松开
	{
		ucKeyFlag = 0;								//清0 防重入
		delay_ms(1);								//消抖
		if(!KEY_READ)
			return PRES_READ;
		else if(!KEY_WRITE)
			return PRES_WRITE;
	}
	else
	{
		if(KEY_READ && KEY_WRITE)
			ucKeyFlag = 1;
	}
	return 0;
}








